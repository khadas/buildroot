## configs/khadas_rk3588s_edge2_defconfig
```kconfig
#include "base/base.config"
#include "bus/can.config"
#include "bus/pci.config"
#include "chips/rk3588_aarch64.config"
#include "font/chinese.config"
#include "fs/exfat.config"
#include "fs/ntfs.config"
#include "fs/vfat.config"
#include "gpu/gpu.config"
#include "multimedia/audio.config"
#include "multimedia/camera.config"
#include "multimedia/gst/audio.config"
#include "multimedia/gst/camera.config"
#include "multimedia/gst/rtsp.config"
#include "multimedia/gst/video.config"
#include "multimedia/mpp.config"
#include "wifibt/bt.config"
#include "wifibt/wireless.config"
#include "tools/benchmark.config"
#include "tools/common.config"
#include "tools/test.config"
#include "network/chromium.config"
#include "npu2.config"
#include "powermanager.config"
#include "weston.config"
#include "products/ipc.config"
BR2_PACKAGE_AVS=y
BR2_PACKAGE_COMMON_ALGORITHM=y
BR2_PACKAGE_HOST_LINUX_HEADERS_CUSTOM_6_1=y
BR2_PACKAGE_IPCWEB_BACKEND=y
# BR2_PACKAGE_IPCWEB_BACKEND_JWT is not set
BR2_PACKAGE_IPCWEB_BACKEND_USE_RKIPC=y
BR2_PACKAGE_IVA=y
BR2_PACKAGE_NGINX=y
BR2_PACKAGE_NGINX_HTTP_FLV_LIVE=y
BR2_PACKAGE_NTP=y
BR2_PACKAGE_PCRE=y
BR2_PACKAGE_RKFSMK=y
BR2_PACKAGE_RKIPC=y
BR2_PACKAGE_RKIPC_RK3588_MULTI_IPC=y
BR2_PACKAGE_ROCKCHIP_MALI_HAS_DUMMY=y
BR2_PACKAGE_ROCKCHIP_MALI_HAS_GBM=y
BR2_PACKAGE_SAMPLES=y
BR2_PACKAGE_SAMPLES_RK3588=y
BR2_PACKAGE_UTIL_LINUX_RFKILL=y
BR2_PACKAGE_VIM=y
BR2_ROOTFS_OVERLAY="board/rockchip/common/base board/rockchip/rk3588/fs-overlay/ board/khadas/Edge2/fs-overlay"
BR2_TARGET_GENERIC_ISSUE="Welcome to Edge2 Buildroot"
BR2_TARGET_GENERIC_ROOT_PASSWD="khadas"
```

## configs/rockchip_rk3576_cluster_defconfig
```kconfig
#include "base/base.config"
#include "bus/can.config"
#include "bus/pci.config"
#include "chips/rk3576_aarch64.config"
#include "font/chinese.config"
#include "fs/exfat.config"
#include "fs/ntfs.config"
#include "fs/vfat.config"
#include "base/base.config"
#include "gpu/gpu.config"
#include "weston.config"
#include "network/network.config"
#include "tools/benchmark.config"
#include "tools/common.config"
#include "tools/test.config"
#include "network/chromium.config"
BR2_GDB_VERSION_12=y
BR2_PACKAGE_BRIDGE_UTILS=y
BR2_PACKAGE_ETHTOOL=y
BR2_PACKAGE_FLAC=y
BR2_PACKAGE_GDB=y
BR2_PACKAGE_GDB_DEBUGGER=y
BR2_PACKAGE_HOST_GDB=y
BR2_PACKAGE_HOST_LINUX_HEADERS_CUSTOM_6_1=y
BR2_PACKAGE_IPERF3=y
BR2_PACKAGE_LIBERATION=y
BR2_PACKAGE_LIBNSS=y
BR2_PACKAGE_LIBV4L=y
BR2_PACKAGE_LIBV4L_UTILS=y
BR2_PACKAGE_LIBVPX=y
BR2_PACKAGE_LIBXSLT=y
BR2_PACKAGE_PANGO=y
# BR2_PACKAGE_ROCKCHIP_MALI is reset to default
BR2_PACKAGE_WEBP=y
BR2_PACKAGE_WEBP_DEMUX=y
BR2_PACKAGE_WEBP_MUX=y
BR2_PACKAGE_WESTON_DEFAULT_PIXMAN=y
BR2_PACKAGE_WESTON_WAYLAND=y
BR2_ROOTFS_OVERLAY+="board/rockchip/rk3576/fs-overlay-cluster/"
BR2_SYSTEM_BIN_SH_BUSYBOX=y
```
